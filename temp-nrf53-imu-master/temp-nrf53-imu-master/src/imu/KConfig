## temp-nrf53-imu-master/temp-nrf53-imu-master/src/imu/KConfig
```kconfig
menu "Imu"

menu "Stack sizes"

config IMU_THREAD_STACK_SIZE
	int "Stack size for the IMU thread"
	default 1024

config IMU_THREAD_PRIORITY
	int "Priority for the IMU thread"
	default 5

endmenu # Stack sizes

endmenu # Imu
```
