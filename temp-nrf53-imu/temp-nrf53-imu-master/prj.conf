## Kconfig
```
# SPDX-License-Identifier: None
#
# Copyright (c) 2023 Merlyn Mind, Inc.
#

menu "Solo Dongle V2 Configuration"

config FW_VER_STR
	string "Firmware version string"
	default "v0.0.0"
	help
	  Firmware version string.

config USB_AUDIO
	bool "Enable USB Audio."
	default y

config DECODE_AUDIO
	bool "Decode SBC audio to PCM."
	default y

config DEBUG_BUILD
	bool "Enable debug functionality."
	default n

endmenu

menu "Zephyr Kernel"
source "Kconfig.zephyr"
endmenu

rsource "src/imu/Kconfig"
```

## prj.conf
```kconfig
CONFIG_SYSTEM_WORKQUEUE_STACK_SIZE=2048
CONFIG_MAIN_STACK_SIZE=4096
CONFIG_HEAP_MEM_POOL_SIZE=8192
CONFIG_NET_BUF=y
CONFIG_PIPES=y

CONFIG_BT=y
CONFIG_BT_CENTRAL=y
CONFIG_BT_L2CAP_TX_MTU=150
CONFIG_BT_L2CAP_TX_BUF_COUNT=6
CONFIG_BT_GATT_CLIENT=y
CONFIG_BT_GATT_DM=y
CONFIG_BT_HOGP=y
CONFIG_BT_GATT_AUTO_UPDATE_MTU=y
CONFIG_BT_SCAN=y
CONFIG_BT_SCAN_FILTER_ENABLE=y
CONFIG_BT_SCAN_UUID_CNT=1
CONFIG_BT_SCAN_ADDRESS_CNT=1
CONFIG_BT_SCAN_MANUFACTURER_DATA_CNT=1
CONFIG_BT_PRIVACY=y
CONFIG_BT_BUF_ACL_RX_SIZE=251
CONFIG_BT_IAS_CLIENT=y

CONFIG_BT_SMP=y
CONFIG_BT_BONDABLE=y
CONFIG_BT_MAX_PAIRED=1

CONFIG_SERIAL=y
CONFIG_UART_INTERRUPT_DRIVEN=y
CONFIG_UART_LINE_CTRL=y

CONFIG_USB_DEVICE_STACK=y
CONFIG_USB_COMPOSITE_DEVICE=y
CONFIG_USB_DEVICE_INITIALIZE_AT_BOOT=n
CONFIG_USB_DEVICE_VID=0x6666
CONFIG_USB_DEVICE_PID=0x0020
CONFIG_USB_DEVICE_PRODUCT="Merlyn Mind Solo"
CONFIG_USB_DEVICE_MANUFACTURER="Merlyn Mind"
CONFIG_USB_DEVICE_HID=y
CONFIG_USB_HID_DEVICE_COUNT=1
CONFIG_USB_CDC_ACM=y
CONFIG_USB_CDC_ACM_RINGBUF_SIZE=2048

# Flash
CONFIG_FLASH=y
CONFIG_FLASH_PAGE_LAYOUT=y
CONFIG_FLASH_MAP=y
CONFIG_STREAM_FLASH=y

CONFIG_SETTINGS=y
CONFIG_NVS=y
CONFIG_BT_SETTINGS=y

CONFIG_CONSOLE=y
CONFIG_UART_CONSOLE=y
CONFIG_LOG_BACKEND_UART=y
CONFIG_SHELL_LOG_BACKEND=n
CONFIG_UART_LINE_CTRL=y
CONFIG_USB_CDC_ACM_LOG_LEVEL_OFF=y

# Logging
CONFIG_LOG=y
CONFIG_USB_DRIVER_LOG_LEVEL_ERR=y
CONFIG_USB_DEVICE_LOG_LEVEL_INF=y
CONFIG_USB_DEVICE_LOG_LEVEL_DBG=n

CONFIG_BT_GATT_DM_DATA_PRINT=y

CONFIG_USB_DEVICE_AUDIO=y
CONFIG_USB_DEVICE_OS_DESC=y

CONFIG_I2C=y
CONFIG_FPU=y
CONFIG_PRINTK=y
CONFIG_LOG=y
CONFIG_LOG_DEFAULT_LEVEL=1
CONFIG_UART_CONSOLE=y    
CONFIG_GPIO=y
CONFIG_FP_HARDABI=y

# IMU Work
CONFIG_IMU_THREAD_PRIORITY=5
CONFIG_IMU_THREAD_STACK_SIZE=1024
```

## src/main.c
```c
#include <assert.h>
#include <stdbool.h>
#include <stdint.h>
#include <string.h>
#include <inttypes.h>
#include <stdio.h>

// Zephyr Headers
#include <zephyr/device.h>
#include <zephyr/kernel.h>
#include <zephyr/logging/log.h>
#include <zephyr/sys/util.h>
#include <zephyr/drivers/i2c.h>
#include <zephyr/devicetree.h>
#include <zephyr/drivers/gpio.h>

#include "hid.h"
#include "imu/imu.h"

#include <zephyr/logging/log.h>

//This is my modification in main.c

LOG_MODULE_REGISTER(app, LOG_LEVEL_DBG);

static const struct gpio_dt_spec air_mouse_btn = GPIO_DT_SPEC_GET(DT_ALIAS(sw3), gpios);
static struct gpio_callback air_mouse_btn_cb_data;

void write_to_mouse_hid(uint8_t x, uint8_t y) {
  uint8_t message[4] = {0};
  message[1] = x;
  message[2] = y;

  int ret = hid_write(message);
  if (ret) {
    LOG_WRN("Could not write to USB %d, %d: %d", message[1], message[2], ret);
  }
}

void change_imu_status_button_pressed(const struct device *dev, struct gpio_callback *cb, uint32_t pins) {
  imu_switch_status();
}

int main(void) {
  LOG_INF("Started IMU application");

  int ret;

  ret = hid_devices_init();
  if (ret) {
    LOG_ERR("Unable to start up HID device: %d", ret);
    return ret;
  }

  // Setting up GPIO to enable / disable on button click
  gpio_init_callback(&air_mouse_btn_cb_data, change_imu_status_button_pressed, BIT(air_mouse_btn.pin));
  gpio_add_callback(air_mouse_btn.port, &air_mouse_btn_cb_data);

  ret = imu_device_init(false, write_to_mouse_hid);
  if (ret) {
    LOG_ERR("Unable to start IMU: %d", ret);
    return ret;
  }

  while (1) {
    k_msleep(1);
  }
}
```

## src/hid.c
```c
#include <string.h>

#include <zephyr/device.h>
#include <zephyr/drivers/gpio.h>
#include <zephyr/input/input.h>
#include <zephyr/kernel.h>
#include <zephyr/sys/util.h>
#include <zephyr/usb/usb_device.h>
#include <zephyr/usb/usb_device.h>

#include <zephyr/usb/class/usb_hid.h>

static const uint8_t mouse_report_desc[] = HID_MOUSE_REPORT_DESC(2);
const struct device *hid_mouse;

int hid_write(uint8_t message[4]) { return hid_int_ep_write(hid_mouse, message, 4, NULL); }

int hid_devices_init(void) {
  hid_mouse = device_get_binding("HID_0");
  if (hid_mouse == NULL) {
    return 1;
  }

  usb_hid_register_device(hid_mouse, mouse_report_desc, sizeof(mouse_report_desc), NULL);

  if (usb_hid_init(hid_mouse)) {
    return 1;
  }

  if (usb_enable(NULL)) {
    return 1;
  }

  return 0;
}
```
